## firmware/cam/main/Kconfig.projbuild
```kconfig
menu "kibbl. cam"

    choice KIBBL_BOARD
        prompt "Camera board"
        default KIBBL_BOARD_AI_THINKER if IDF_TARGET_ESP32
        default KIBBL_BOARD_FREENOVE_S3 if IDF_TARGET_ESP32S3
        help
            Selects the camera, led and flash pins in KL_hw.h.

        config KIBBL_BOARD_AI_THINKER
            bool "AI-Thinker ESP32-CAM (ESP32-S, OV2640)"
            depends on IDF_TARGET_ESP32
        config KIBBL_BOARD_FREENOVE_S3
            bool "Freenove ESP32-S3-WROOM CAM"
            depends on IDF_TARGET_ESP32S3
        config KIBBL_BOARD_EMONI
            bool "EMONI EHW0014-0011 as a kibbl. feeder (camera and the iris motor)"
            depends on IDF_TARGET_ESP32S3
    endchoice

    config KIBBL_PRINTER
        bool "A 3D printer on the home network (Bambu Lab, local MQTT)"
        default y if KIBBL_BOARD_AI_THINKER
        select ESP_TLS_INSECURE
        select ESP_TLS_SKIP_SERVER_CERT_VERIFY
        help
            The camera logs into a Bambu Lab printer on the same network (its access
            code, set from the app) and passes its state and commands through the
            server link (docs/printer.md). The printer's own certificate is not
            checked; the server's and the updates' still are.

    config KIBBL_LOCAL_HTTP
        bool "Local stream on the home network"
        default y
        help
            http://<device>/ shows the stream without the server. Every request needs
            the local key the device prints with {"cmd":"info"}.

    config KIBBL_STREAM_MAX_FPS
        int "Highest frame rate the server may ask for"
        range 1 30
        default 30
        help
            The sensor gives about 25-30 fps up to CIF; larger frames and the uplink
            bring it down by themselves.

    config KIBBL_LIGHT_MAX_PERCENT
        int "Flash led duty cycle at level 100, in percent"
        range 1 100
        default 40
        help
            The AI-Thinker flash led draws up to 200 mA at full duty; more than half
            of it browns out boards on a weak usb supply.

endmenu
```

## firmware/components/kibbl_core/Kconfig.projbuild
```kconfig
menu "kibbl. core"

    config KIBBL_SERVER_URL
        string "Server websocket url"
        default "wss://kibbl.tail529b44.ts.net/device/socket"
        help
            Where the device sends its data and takes its commands from. wss:// is
            checked against the ESP-IDF certificate bundle. The serial command
            {"cmd":"server","url":"..."} overrides it and keeps the value in nvs.

endmenu
```

## firmware/main/Kconfig.projbuild
```kconfig
menu "kibbl."

    choice KIBBL_BOARD
        prompt "Camera board"
        default KIBBL_BOARD_AI_THINKER if IDF_TARGET_ESP32
        default KIBBL_BOARD_FREENOVE_S3 if IDF_TARGET_ESP32S3
        help
            Selects the camera, led and flash pins in KL_hw.h.

        config KIBBL_BOARD_AI_THINKER
            bool "AI-Thinker ESP32-CAM (ESP32-S, OV2640)"
            depends on IDF_TARGET_ESP32
        config KIBBL_BOARD_FREENOVE_S3
            bool "Freenove ESP32-S3-WROOM CAM"
            depends on IDF_TARGET_ESP32S3
    endchoice

    config KIBBL_SERVER_URL
        string "Server websocket url"
        default "ws://10.0.1.99:8790/device/socket"
        help
            Where the device sends its frames and takes its commands from. wss:// is
            checked against the ESP-IDF certificate bundle. The serial command
            {"cmd":"server","url":"..."} overrides it and keeps the value in nvs.

    config KIBBL_PROV_POP
        string "Wi-Fi provisioning proof of possession"
        default "kibbl-setup"
        help
            Asked by the ESP SoftAP Prov app while the device is unprovisioned.

    config KIBBL_LOCAL_HTTP
        bool "Local stream on the home network"
        default y
        help
            http://<device>/ shows the stream without the server. Every request needs
            the local key the device prints with {"cmd":"info"}.

    config KIBBL_STREAM_MAX_FPS
        int "Highest frame rate the server may ask for"
        range 1 30
        default 15

    config KIBBL_LIGHT_MAX_PERCENT
        int "Flash led duty cycle at level 100, in percent"
        range 1 100
        default 40
        help
            The AI-Thinker flash led draws up to 200 mA at full duty; more than half
            of it browns out boards on a weak usb supply.

endmenu
```
